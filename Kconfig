## Kconfig
```kconfig
mainmenu "Project Configuration"

config TEST
	bool "TEST option"
	help
		this should only cause main.c to rebuild

config TEST_INC
	bool "test option from inc"

config TEST_UNRELATED
	bool "this is an unrelated option, should only build unrelated.c not main.c"
```
